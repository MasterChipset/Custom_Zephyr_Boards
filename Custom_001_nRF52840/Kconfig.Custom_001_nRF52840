## Custom_001_nRF52840/Kconfig.defconfig
```kconfig
if BOARD_CUSTOM_001_NRF52840

config BT_CTLR
	default BT

endif # BOARD_CUSTOM_001_NRF52840
```

## Custom_001_nRF52840/board.yml
```yaml
board:
  name: Custom_001_nRF52840
  vendor: ZRiver
  socs:
    - name: nrf52840
```
